## conf/layer.conf
```bitbake
# We have a conf and classes directory, add to BBPATH
BBPATH .= ":${LAYERDIR}"

# We have recipes-* directories, add to BBFILES
BBFILES += "${LAYERDIR}/recipes-*/*/*.bb \
            ${LAYERDIR}/recipes-*/*/*.bbappend"

BBFILE_COLLECTIONS += "swupdate-dev"
BBFILE_PATTERN_swupdate-dev = "^${LAYERDIR}/"
BBFILE_PRIORITY_swupdate-dev = "6"

LAYERDEPENDS_swupdate-dev = "core"
LAYERSERIES_COMPAT_swupdate-dev = "dunfell"
LAYERDEPENDS_swupdate-dev = "swupdate"

BBFILES_DYNAMIC += " \
    qt5-layer:${LAYERDIR}/dynamic-layers/qt5-layer/*/*/*.bb \
    qt5-layer:${LAYERDIR}/dynamic-layers/qt5-layer/*/*/*.bbappend \
"
```

## recipes-support/swupdate/swupdate/imx7s-warp/defconfig
```kconfig
CONFIG_SYSTEMD=y
CONFIG_HW_COMPATIBILITY=y
# CONFIG_MTD is not set
CONFIG_UBOOT_NEWAPI=y
CONFIG_DOWNLOAD=y
CONFIG_HASH_VERIFY=y
CONFIG_ENCRYPTED_IMAGES=y
CONFIG_SURICATTA=y
CONFIG_SURICATTA_SSL=y
CONFIG_SURICATTA_STATE_CHOICE_BOOTLOADER=y
CONFIG_WEBSERVER=y
# CONFIG_MONGOOSEIPV6 is not set
CONFIG_MONGOOSESSL=y
CONFIG_RAW=y
CONFIG_LUASCRIPTHANDLER=y
CONFIG_SHELLSCRIPTHANDLER=y
CONFIG_ARCHIVE=y
CONFIG_REMOTE_HANDLER=y
CONFIG_SWUFORWARDER_HANDLER=y
CONFIG_BOOTLOADERHANDLER=y
CONFIG_UCFWHANDLER=y
```

## wic/swu-stm32mp1.wks
```
part fsbl1 --source rawcopy --sourceparams="file=u-boot-spl.stm32" --ondisk mmcblk --align 1 --size 256k --part-name fsbl1
part fsbl2 --source rawcopy --sourceparams="file=u-boot-spl.stm32" --ondisk mmcblk --align 1 --size 256k --part-name fsbl2
part u-boot --source rawcopy --sourceparams="file=u-boot.img" --ondisk mmcblk --align 1 --size 2M --part-name uboot
part /boot --source bootimg-partition --ondisk mmcblk --fstype=vfat --label boot --active --align 1 --size 20
part / --source rootfs --ondisk mmcblk --fstype=ext4 --label rootfs_A  --align 1 --extra-space 200
part / --source rootfs --ondisk mmcblk --fstype=ext4 --label rootfs_B  --align 1 --extra-space 200
part /data --ondisk mmcblk --fstype=ext4 --label data --size 128M --align 1 --extra-space 0

bootloader --ptable gpt
```
